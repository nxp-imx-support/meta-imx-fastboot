## conf/layer.conf
```bitbake
# We have a conf and classes directory, add to BBPATH
BBPATH .= ":${LAYERDIR}"

# We have recipes-* directories, add to BBFILES
BBFILES += "${LAYERDIR}/recipes-*/*/*.bb \
            ${LAYERDIR}/recipes-*/*/*.bbappend"

BBFILE_COLLECTIONS += "meta-imx-fastboot"
BBFILE_PATTERN_meta-imx-fastboot = "^${LAYERDIR}/"
BBFILE_PRIORITY_meta-imx-fastboot = "6"

LAYERDEPENDS_meta-imx-fastboot = "core"
LAYERSERIES_COMPAT_meta-imx-fastboot = "scarthgap"

UBOOT_TARGET = "u-boot-atf-container.img"
UBOOT_TARGET:mx8m-generic-bsp = "u-boot.itb"

KERNEL_TARGET = "kernel-atf-container.img"
KERNEL_TARGET:mx8m-generic-bsp = "kernel-atf.itb"

UBOOT_MAKE_TARGET:mx8qxp-generic-bsp = ""
SPL_BINARY:mx8qxp-generic-bsp = "spl/u-boot-spl.bin"
IMXBOOT_TARGETS_SD:mx8qxp-generic-bsp = "flash_spl"
IMXBOOT_TARGETS_SD:remove:mx8qxp-generic-bsp = "flash_regression_linux_m4"
IMXBOOT_TARGETS_SD:prepend:mx8qxp-generic-bsp = "flash_linux_m4 "

MACHINE_FEATURES:remove = "optee"
```

## conf/machine/imx8mmevk-fastboot.conf
```bitbake
#@TYPE: Machine
#@NAME: i.MX 8M Mini EVK Falcon Mode
#@DESCRIPTION: i.MX 8M Mini Evaluation Kit Falcon Mode configuration
#@MAINTAINER: Elena Popa <elena.popa@nxp.com>

require conf/machine/imx8mmevk.conf

UBOOT_CONFIG_BASENAME = "imx8mm_evk_falcon"

IMAGE_BOOT_FILES:append = " \
    u-boot-atf.itb \
    kernel-atf.itb \
"
```

## conf/machine/imx8mnevk-fastboot.conf
```bitbake
#@TYPE: Machine
#@NAME: i.MX 8M Nano EVK Falcon Mode
#@DESCRIPTION: i.MX 8M Nano Evaluation Kit Falcon Mode configuration
#@MAINTAINER: Elena Popa <elena.popa@nxp.com>

require conf/machine/imx8mnevk.conf

UBOOT_CONFIG_BASENAME = "imx8mn_evk_falcon"

IMAGE_BOOT_FILES:append = " \
    u-boot-atf.itb \
    kernel-atf.itb \
"
```

## conf/machine/imx8mpevk-fastboot.conf
```bitbake
#@TYPE: Machine
#@NAME: i.MX 8M Plus EVK Falcon Mode
#@DESCRIPTION: i.MX 8M Plus Evaluation Kit Falcon Mode configuration
#@MAINTAINER: Elena Popa <elena.popa@nxp.com>

require conf/machine/imx8mpevk.conf

UBOOT_CONFIG_BASENAME = "imx8mp_evk_falcon"

IMAGE_BOOT_FILES:append = " \
    u-boot-atf.itb \
    kernel-atf.itb \
"
```

## conf/machine/imx93evk-fastboot.conf
```bitbake
#@TYPE: Machine
#@NAME: i.MX 93 11x11 EVK Falcon Mode
#@DESCRIPTION: i.MX 93 11x11 Evaluation Kit Falcon Mode configuration
#@MAINTAINER: Elena Popa <elena.popa@nxp.com>

require conf/machine/imx93evk.conf

UBOOT_CONFIG_BASENAME = "imx93_11x11_evk_falcon"

IMAGE_BOOT_FILES:append = " \
    u-boot-atf-container.img \
    kernel-atf-container.img \
"
```

## conf/machine/imx95-19x19-lpddr5-evk-fastboot.conf
```bitbake
#@TYPE: Machine
#@NAME: i.MX 95 19x19 EVK Falcon Mode
#@DESCRIPTION: i.MX 95 19x19 Evaluation Kit Falcon Mode configuration
#@MAINTAINER: Elena Popa <elena.popa@nxp.com>

require conf/machine/imx95-19x19-lpddr5-evk.conf

UBOOT_CONFIG_BASENAME = "imx95_19x19_evk_falcon"

UBOOT_CONFIG[sd] = "${UBOOT_CONFIG_BASENAME}_defconfig,sdcard"

UBOOT_DTB_NAME = "imx95-19x19-evk.dtb"

IMAGE_BOOT_FILES:append = " \
    u-boot-atf-container.img \
    kernel-atf-container.img \
"
```
